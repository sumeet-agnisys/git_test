# chip_name_model: IP-XACT component
VLNV Agnisys_Inc.:Agnisys_Inc.:chip_name_model:1.0

## Parameters
addr_width = 5
bus_width = 32

## Bus interfaces (logical=physical port)
default_map: slave AGNISYS:AGNISYS:AXI:1.0, memory map chip_name
  aclk=aclk, aresetn=aresetn, awaddr=awaddr, awvalid=awvalid, awready=awready, awprot=awprot, wdata=wdata, wvalid=wvalid, wready=wready, wstrb=wstrb, bresp=bresp, bready=bready, bvalid=bvalid, araddr=araddr, arvalid=arvalid, arready=arready, arprot=arprot, rdata=rdata, rvalid=rvalid, rready=rready, rresp=rresp

## Ports
in aclk
in aresetn
in awaddr[addr_width -1:0]
in awvalid
out awready
in awprot[2:0]
in wdata[bus_width -1:0]
in wvalid
out wready
in wstrb[(bus_width div 8 )-1:0]
out bresp[1:0]
in bready
out bvalid
in araddr[addr_width -1:0]
in arvalid
out arready
in arprot[2:0]
out rdata[bus_width -1:0]
out rvalid
in rready
out rresp[1:0]
out chip_nameblock1_idsreg1_enb
out chip_nameblock1_idsreg1_fld_r[31:0]
out chip_nameblock1_idsreggroup1_reg1_enb
out chip_nameblock1_idsreggroup1_reg1_fld_r[31:0]
out chip_nameblock1_idsreggroup1_reg2_fld1_r[31:0]
out chip_nameblock2_idsreggroup1_reg1_enb
out chip_nameblock2_idsreggroup1_reg1_fld_r[31:0]
out chip_nameblock2_idsreggroup1_reg2_fld1_r[31:0]
out chip_nameblock2_idsref_name_reg1_enb
out chip_nameblock2_idsref_name_reg1_fld_r[31:0]
out chip_nameblock2_idsref_name_reggroup1_reg1_enb
out chip_nameblock2_idsref_name_reggroup1_reg1_fld_r[31:0]
out chip_nameblock2_idsref_name_reggroup1_reg2_fld1_r[31:0]
in s1
in s2

## Address spaces and blocks
chip_name.block1: base 0x00, range 0xC, width 32
chip_name.block2: base 0x0C, range 0x14, width 32

## Registers
Registers are 32-bit, read-write, reset 0x0 unless marked. A register's access mark holds for its fields unless they carry their own. Offsets are from the block's base; lines under a group give offsets from that group; [hi:lo] are bit positions; {n}, {i} and the like mark numbered series; 'fields as' and 'values as' point back to an identical list; <NAME> marks a mode.

## chip_name.block1
Base 0x00000000
0x00 reg1 — ,
  [31:0] fld
0x04 reggroup1 group
  0x00 reg1
    [31:0] fld
  0x04 reg2 ro
    [31:0] fld1

## chip_name.block2
Base 0x0000000C
0x00 reggroup1 group
  0x00 reg1
    [31:0] fld
  0x04 reg2 ro
    [31:0] fld1
0x08 ref_name group
  0x00 reg1 — ,
    [31:0] fld
  0x04 ref_name_reggroup1 group
    0x00 reg1
      [31:0] fld
    0x04 reg2 ro
      [31:0] fld1
