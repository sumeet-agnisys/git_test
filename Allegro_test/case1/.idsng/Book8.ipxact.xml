# chip1_model: IP-XACT component
VLNV Agnisys_Inc.:Agnisys_Inc.:chip1_model:1.0

## Parameters
addr_width = 4
bus_width = 32

## Bus interfaces (logical=physical port)
default_map: slave AGNISYS:AGNISYS:AXI:1.0, memory map chip1
  aclk=aclk, aresetn=aresetn, awaddr=awaddr, awvalid=awvalid, awready=awready, awprot=awprot, wdata=wdata, wvalid=wvalid, wready=wready, wstrb=wstrb, bresp=bresp, bready=bready, bvalid=bvalid, araddr=araddr, arvalid=arvalid, arready=arready, arprot=arprot, rdata=rdata, rvalid=rvalid, rready=rready, rresp=rresp

## Ports
in aclk
in aresetn
in awaddr[addr_width -1:0]
in awvalid
out awready
in awprot[2:0]
in wdata[bus_width -1:0]
in wvalid
out wready
in wstrb[(bus_width div 8 )-1:0]
out bresp[1:0]
in bready
out bvalid
in araddr[addr_width -1:0]
in arvalid
out arready
in arprot[2:0]
out rdata[bus_width -1:0]
out rvalid
in rready
out rresp[1:0]
out chip1block1_idsreggroup1_reg1_enb
out chip1block1_idsreggroup1_reg1_f1_r[31:0]
out chip1block2_idsreg2_enb
in chip1block2_idsreg2_f1_in[31:0]
in chip1block2_idsreg2_f1_in_enb
out chip1block2_idsreg2_f1_r[31:0]
out chip1block2_idsblock3_reggroup1_reg1_enb
out chip1block2_idsblock3_reggroup1_reg1_f1_r[31:0]

## Address spaces and blocks
chip1.block1: base 0x0, range 0x4, width 32
chip1.block2: base 0x4, range 0x8, width 32

## Registers
Registers are 32-bit, read-write, reset 0x0 unless marked. A register's access mark holds for its fields unless they carry their own. Offsets are from the block's base; lines under a group give offsets from that group; [hi:lo] are bit positions; {n}, {i} and the like mark numbered series; 'fields as' and 'values as' point back to an identical list; <NAME> marks a mode.

## chip1.block1
Base 0x00000000
0x00 reggroup1 group
  0x00 reg1
    [31:0] f1

## chip1.block2
Base 0x00000004
0x00 reg2
  [31:0] f1
0x04 block3 group
  0x00 block3_reggroup1 group
    0x00 reg1
      [31:0] f1
